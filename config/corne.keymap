// Copyright (c) 2022 The ZMK Contributors
// SPDX-License-Identifier: MIT

#include "../zmk-nodefree-config/keypos_def/keypos_36keys.h"

/* map extra keys */
#define X_LH  &none         // thumb row, left
#define X_RH  &none         // thumb row, right

/* activate bluetooth */
#define CONFIG_WIRELESS 1

/* source the main keymap */
#include "base.keymap"

/* BS Corne bodge */
&nice_view_spi {
    cs-gpios = <&pro_micro 16 GPIO_ACTIVE_HIGH>;
};

/* use 5-column layout */
/ { chosen { zmk,matrix_transform = &five_column_transform; }; };
